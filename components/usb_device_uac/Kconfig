## components/usb_device_uac/Kconfig
```kconfig
menu "USB Device UAC Configuration"

    config TUSB_VID
        hex "USB Device VID"
        default 0x303A

    config TUSB_PID
        hex "USB Device PID"
        default 0x8000

    config TUSB_MANUFACTURER
        string "USB Device Manufacture"
        default "Espressif"

    config TUSB_PRODUCT
        string "Product Name"
        default "ESP UAC Device"

    config TUSB_SERIAL_NUM
        string "Product ID"
        default "12345678"

    # ===== 本地修改 #3：HID 键盘接口 =====
    config UAC_HID_KEY
        bool "复合一个 HID 键盘接口（对端唤醒键 -> 电脑回车键）"
        default y
        help
            打开后这个 dongle 在电脑上除了是一只麦克风，还是一只键盘：
            对端 espnow_duo 那块板上的唤醒键（GPIO4）按一下，
            电脑就收到一次回车键。

            回车在电脑上本来就有现成语义（聊天软件发送消息 / 命令行执行 /
            PPT 翻下一页 / 对话框确认），所以不用装任何软件就能看到现象。

            要换成别的键，改 main/hid_key.c 顶部的 TAP_KEYCODE。

            关掉的话 USB 描述符退回纯 UAC，和加这个功能之前完全一致。
            排查 Windows 枚举问题（设备管理器里的黄色感叹号、代码 10）时，
            先关掉这一项看问题还在不在 —— 见 README 第三节记的两次描述符踩坑。

    choice TINYUSB_RHPORT
        prompt "TinyUSB PHY"
        default TINYUSB_RHPORT_HS if IDF_TARGET_ESP32P4
        default TINYUSB_RHPORT_FS
        help
            Allows set the USB PHY Controller for TinyUSB: HS (USB OTG2.0 PHY for HighSpeed)

        config TINYUSB_RHPORT_HS
            depends on IDF_TARGET_ESP32P4
            bool "High Speed"

        config TINYUSB_RHPORT_FS
            bool "Full Speed"
    endchoice

    # Insert UAC config
    orsource "./Kconfig.uac"

endmenu
```
